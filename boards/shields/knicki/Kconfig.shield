## boards/shields/knicki/Kconfig.shield
```kconfig
config SHIELD_KNICKI
	def_bool $(shields_list_contains,knicki)
config SHIELD_KNICKI_DONGLE
	def_bool $(shields_list_contains,knicki_dongle)
```

## boards/shields/nicki/Kconfig.defconfig
```kconfig
if SHIELD_NICKI

config ZMK_KEYBOARD_NAME
	default "NICKI"

config ZMK_POINTING
    default y
    
config ZMK_SLEEP
    default y

endif
```

## boards/shields/zehna/Kconfig.shield
```kconfig
config SHIELD_ZEHNA
	def_bool $(shields_list_contains,zehna)
config SHIELD_ZEHNA_DONGLE
	def_bool $(shields_list_contains,zehna_dongle)
```
